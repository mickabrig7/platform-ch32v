# CH32H417 register map
Vendor: WCH Ltd.; File version: 1.2
CH32H417 View File
Registers are 32-bit, read-write, reset 0x0 unless marked. A register's access mark holds for its fields unless they carry their own. Offsets are from the block's base; lines under a group give offsets from that group; [hi:lo] are bit positions; {n}, {i} and the like mark numbered series; 'fields as' and 'values as' point back to an identical list; <NAME> marks a mode.

## Memory map
0x0E00C000 HSEM size 0x1000
0x1FFFF7E0 ESIG size 0x200 — ESIG configuration
0x40000000 TIM2 size 0x400 — General purpose timer
0x40000400 TIM3 size 0x400
0x40000800 TIM4 size 0x400
0x40000C00 TIM5 size 0x400
0x40001000 TIM6 size 0x400 — Basic timer
0x40001400 TIM7 size 0x400
0x40001800 USART6 size 0x400
0x40001C00 USART7 size 0x400
0x40002000 USART8 size 0x400
0x40002400 LPTIM1 size 0x400 — Low-power timer 1
0x40002800 RTC size 0x400 — Real time clock
0x40002C00 WWDG size 0x400 — Window watchdog
0x40003000 IWDG size 0x400 — Independent watchdog
0x40003400 LPTIM2 size 0x400
0x40003800 SPI2 size 0x400
0x40003C00 SPI3 size 0x400 — Serial peripheral interface
0x40004000 SPI4 size 0x400
0x40004400 USART2 size 0x400
0x40004800 USART3 size 0x400
0x40004C00 USART4 size 0x400
0x40005000 USART5 size 0x400
0x40005400 I2C1 size 0x400 — Inter integrated circuit
0x40005800 I2C2 size 0x400
0x40005C00 I2C3 size 0x400
0x40006400 CAN1 size 0x200 — Controller area network
0x40006800 CAN2 size 0x200
0x40007000 PWR size 0x400 — Power control
0x40007400 DAC size 0x400 — Digital to analog converter
0x40007800 CAN3 size 0x200
0x40008400 SWPMI size 0x400 — Single Wire Protocol Master Interface
0x40010000 AFIO size 0x400 — Alternate function I/O
0x40010400 EXTI size 0x400
0x40010800 GPIOA size 0x400 — General purpose I/O
0x40010C00 GPIOB size 0x400
0x40011000 GPIOC size 0x400
0x40011400 GPIOD size 0x400
0x40011800 GPIOE size 0x400
0x40011C00 GPIOF size 0x400
0x40012400 ADC1 size 0x400 — Analog to digital converter
0x40012800 ADC2 size 0x400
0x40012C00 TIM1 size 0x400 — Advanced timer
0x40013000 SPI1 size 0x400 — Serial peripheral interface
0x40013400 TIM8 size 0x400
0x40013800 USART1 size 0x400 — Universal synchronous asynchronous receiver transmitter
0x40013C00 TIM12 size 0x400
0x40014000 I2C4 size 0x400
0x40014400 I3C size 0x400 — Improved inter-integrated circuit
0x40014800 LTDC size 0x400 — LCD-TFT Controller
0x40014C00 TIM9 size 0x400 — General purpose timer
0x40015000 TIM10 size 0x400
0x40015400 TIM11 size 0x400
0x40015800 SAI size 0x400
0x40016800 GPHA size 0x400
0x40016C00 ECDC size 0x400
0x40017000 DFSDM size 0x400 — Digital filter for sigma delta modulators
0x40017400 HSADC size 0x400 — High speed ADC
0x40017800 OPA size 0x400 — OPA configuration
0x40018000 SDIO size 0x400 — Secure digital input/output interface
0x40020000 DMA1 size 0x400 — DMA1 controller
0x40020400 DMA2 size 0x400
0x40020800 DMAMUX size 0x400 — DMA request multiplexer
0x40021000 RCC size 0x400 — Reset and clock control
0x40022000 FLASH size 0x400
0x40023000 CRC size 0x400 — CRC calculation unit
0x40023C00 RNG size 0x400 — Random number generator
0x40024000 EMMC size 0x400
0x40024400 USBPD size 0x400 — USBPD configuration
0x40024C00 QSPI1 size 0x400
0x40025000 QSPI2 size 0x400
0x40025400 FMC size 0x400
0x40025800 DVP size 0x400 — Digital Video Port
0x40025C00 PIOC size 0x400 — Programmable protocol I/O microcontroller
0x40027C00 SERDES size 0x400 — Serial-parallel interconversion controller and transceiver
0x40028000 ETHERNET_MAC size 0x100 — Ethernet: media access control
0x40028100 ETHERNET_MMC size 0x400 — Ethernet: MAC management counters
0x40028700 ETHERNET_PTP size 0x400 — Ethernet: Precision time protocol
0x40029000 ETHERNET_DMA size 0x400 — Ethernet: DMA controller operation
0x40030000 USBHS size 0x400 — USB register
0x40034000 USBSS size 0x400 — USB3.0 ultra-high speed host /device controller
0x40038000 UHSIF size 0x400 — Universal high speed interface
0x50000000 USB_OTG_FS size 0x40000 — USB FS OTG register
0xE000D000 IPC size 0x1000 — Inter-cpre communication
0xE000E000 PFIC size 0x1000 — Programmable Fast Interrupt Controller
0xE000F000 STK size 0xFFF — SysTick

## Interrupts
16 IPC_CH0 (IPC) — IPC global interrupt 0
17 IPC_CH1 (IPC) — IPC global interrupt 1
18 IPC_CH2 (IPC) — IPC global interrupt 2
19 IPC_CH3 (IPC) — IPC global interrupt 3
28 HSEM — HSEM global interrupt
32 WWDG — Window Watchdog interrupt
33 EXTI15_8 (EXTI) — EXTI Line[15:8] interrupts
34 FLASH — Flash global interrupt
35 RCC — RCC global interrupt
36 EXTI7_0 (EXTI) — EXTI Line[7:0] interrupt
37 SPI1 — SPI1 global interrupt
38 DMA1_CH2 (DMA1) — DMA1 Channel2 global interrupt
39 DMA1_CH3 (DMA1) — DMA1 Channel3 global interrupt
40 DMA1_CH4 (DMA1) — DMA1 Channel4 global interrupt
41 DMA1_CH5 (DMA1) — DMA1 Channel5 global interrupt
42 DMA1_CH6 (DMA1) — DMA1 Channel6 global interrupt
43 DMA1_CH7 (DMA1) — DMA1 Channel7 global interrupt
44 DMA1_CH8 (DMA1) — DMA1 Channel8 global interrupt
45 USART2 — USART2 global interrupt
46 I2C1_EV (I2C1) — I2C1 event interrupt
47 I2C1_ER (I2C1) — I2C1 error interrupt
48 USART1 — USART1 global interrupt
49 SPI2 — SPI2 global interrupt
50 SPI3 — SPI3 global interrupt
51 SPI4 — SPI4 global interrupt
52 I2C2_EV (I2C2) — I2C2 event interrupt
53 I2C2_ER (I2C2) — I2C2 error interrupt
54 USBPD — USBPD global interrupt
55 USBPDWakeUP (USBPD) — USBPD_WKUP global interrupt
56 USBHS — USBHS global interrupt
57 DMA1_CH1 (DMA1) — DMA1 Channel1 global interrupt
58 CAN1_SCE (CAN1) — CAN SCE interrupt
59 CAN1_TX (CAN1) — CAN TX interrupts
60 CAN1_RX0 (CAN1) — CAN RX0 interrupts
60 CAN1_RX1 (CAN1) — CAN RX0 interrupts
62 USBSS — USBSS global interrupt
63 USBSS_LINK (USBSS) — USBSS LINK interrupt
64 USBHSWakeUP (USBHS) — USBHS Wakeup interrupt
65 USBSSWakeUP (USBSS) — USBSS wake-up interrupt
66 RTCAlarm (RTC) — RTC Alarm-clock interrupt
67 USBFS (USB_OTG_FS) — USBFS global interrupt
68 USBFSWakeup (USB_OTG_FS)
69 ADC (ADC1) — ADC global interrupt
70 TIM1_BRK (TIM1) — TIM1 Break interrupt
71 TIM1_UP_ (TIM1) — TIM1 Update interrupt
72 TIM1_TRG_COM (TIM1) — TIM1 Trigger and Commutation interrupts
73 TIM1_CC (TIM1) — TIM1 Capture Compare interrupt
74 TIM2 — TIM2 global interrupt
75 TIM3 — TIM3 global interrupt
76 TIM4 — TIM4 global interrupt
77 TIM5 — TIM5 global interrupt
78 I2C3_EV (I2C3) — I2C3 event interrupt
79 I2C3_ER (I2C3) — I2C3 error interrupt
80 I2C4_EV (I2C4) — I2C4 event interrupt
81 I2C4_ER (I2C4) — I2C4 error interrupt
82 QSPI1 — QSPI1 global interrupt
83 SERDES — SERDES global interrupt
84 USART3 — USART3 global interrupt
85 USART4 — USART4 global interrupt
86 TIM8_BRK (TIM8) — TIM8 Break interrupt
87 TIM8_UP (TIM8) — TIM8 Update interrupt
88 TIM8_TRG_COM (TIM8) — TIM8 Trigger and Commutation interrupts
89 TIM8_CC (TIM8) — TIM8 Capture Compare interrupt
90 TIM9 — TIM9 global interrupt
91 TIM10 — TIM10 global interrupt
92 TIM11 — TIM11 global interrupt
93 TIM12 — TIM12 global interrupt
94 FMC — FMC global interrupt
95 SDMMC (EMMC) — SDMMC global interrupt
96 LPTIM1 — LPTIM global interrupt
97 LPTIM2 — LPTIM2 global interrupt
98 USART5 — USART5 global interrupt
99 USART6 — USART6 global interrupt
100 TIM6 — TIM6 global interrupt
101 TIM7 — TIM7 global interrupt
{n+101} DMA2_CH{n} (DMA2) (n=1..8) — DMA2 Channel{n} global interrupt
110 ETH (ETHERNET_MAC) — Ethernet global interrupt
111 ETHWakeUP (ETHERNET_MAC) — Ethernet Wakeup interrupt
112 CAN2_SCE (CAN2) — CAN SCE interrupt
113 CAN2_TX (CAN2) — CAN TX interrupts
114 CAN2_RX0 (CAN2) — CAN RX0 interrupts
115 CAN2_RX1 (CAN2) — CAN RX1 interrupts
116 USART7 — UART7 global interrupt
117 USART8 — USART8 global interrupt
118 I3C_EV (I3C) — I3C event interrupt
119 I3C_ER (I3C) — I3C error interrupt
120 DVP — DVP global Interrupt interrupt
121 ECDC — ECDC global Interrupt interrupt
122 PIOC — PIOC global interrupt
123 SAI — SAI global interrupt
124 LTDC — LCD-TFT global interrupt
125 GPHA — GPHA global interrupt
127 DFSDM0 (DFSDM) — DFSDM0 global interrupt
128 DFSDM1 (DFSDM) — DFSDM1 global interrupt
131 SWPMI — SWPMI global interrupt
134 QSPI2 — QSPI2 global interrupt
135 SWPMIWakeUP (SWPMI) — SWPMI wake-up interrupt
136 CAN3_SCE (CAN3) — CAN SCE interrupt
137 CAN3_TX (CAN3) — CAN TX interrupts
138 CAN3_RX0 (CAN3) — CAN RX0 interrupts
139 CAN3_RX1 (CAN3) — CAN RX1 interrupts
140 LPTIM2WakeUP (LPTIM2) — LPTIM2 wake-up interrupt
141 LPTIM1WakeUP (LPTIM1) — LPTIM wake-up interrupt
142 I3CWakeUP (I3C) — I3C wakeup interrupt
143 RTC — RTC global interrupt
144 HSADC — HSADC global interrupt
145 UHSIF — UHSIF global interrupt
146 RNG — RNG interrupt
147 SDIO — SDIO global interrupt
